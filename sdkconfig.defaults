## sdkconfig.defaults
```kconfig
CONFIG_ESP_CONSOLE_UART_CUSTOM=y
CONFIG_ESP_CONSOLE_UART_TX_GPIO=7        # 日志 TX
CONFIG_ESP_CONSOLE_UART_RX_GPIO=6        # 日志 RX
CONFIG_ESP_CONSOLE_UART_BAUDRATE=115200
```
